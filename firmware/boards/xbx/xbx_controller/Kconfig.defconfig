## firmware/boards/xbx/xbx_controller/Kconfig.defconfig
```kconfig
if BOARD_XBX_CONTROLLER

config HW_STACK_PROTECTION
	default ARCH_HAS_STACK_PROTECTION

endif # BOARD_XBX_CONTROLLER
```

## firmware/boards/xbx/xbx_controller/board.yml
```yaml
board:
  name: xbx_controller
  full_name: xbx-nrf controller
  socs:
  - name: nrf52840
```

## firmware/boards/xbx/xbx_dongle/Kconfig.defconfig
```kconfig
if BOARD_XBX_DONGLE

config HW_STACK_PROTECTION
	default ARCH_HAS_STACK_PROTECTION

endif # BOARD_XBX_DONGLE
```

## firmware/boards/xbx/xbx_dongle/board.yml
```yaml
board:
  name: xbx_dongle
  full_name: xbx-nrf dongle
  socs:
  - name: nrf52840
```

## firmware/boards/xbx/xbx_dongle/xbx_dongle_nrf52840_defconfig
```kconfig
CONFIG_ARM_MPU=y
CONFIG_GPIO=y

# Console on J3 (debug UART)
CONFIG_SERIAL=y
CONFIG_CONSOLE=y
CONFIG_UART_CONSOLE=y
```
