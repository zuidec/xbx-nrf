/*
 * xbx-nrf dongle without a bootloader: the app owns all flash (SWD only).
 * Zephyr needs this base form; the apps build only for the uf2 variant.
 */

/dts-v1/;
#include "xbx_dongle_nrf52840_common.dtsi"
#include <nordic/nrf52840_partition.dtsi>

/ {
	chosen {
		zephyr,code-partition = &slot0_partition;
	};
};
